## app/Kconfig
```kconfig
# Copyright (c) 2022 Mr. Green's Workshop https://www.MrGreensWorkshop.com
# SPDX-License-Identifier: Apache-2.0

#
# Set the main menu title
# Check out the docs:
# https://docs.zephyrproject.org/latest/develop/application/index.html#application-cmakelists-txt
# https://docs.zephyrproject.org/latest/build/kconfig/menuconfig.html
#
mainmenu "DRO application"

#
# Zephyr configuration options
# Source the Kconfig.zephyr in the Zephyr root directory.
# Check out the docs: https://docs.zephyrproject.org/latest/develop/application/index.html#application-cmakelists-txt
#
menu "Zephyr"
source "Kconfig.zephyr"
endmenu

#
# Set the module name for logging
# Check out the docs: https://docs.zephyrproject.org/latest/services/logging/index.html#logging-in-a-module
#
module = MAIN
module-str = main
source "subsys/logging/Kconfig.template.log_config"
```

## west.yml
```yaml
# Copyright (c) 2022 Mr. Green's Workshop https://www.MrGreensWorkshop.com
# SPDX-License-Identifier: Apache-2.0

manifest:
  defaults:
    # select between 'zephyr-rtos' or 'your-zephyr-rtos-fork'
    remote: zephyr-rtos

  remotes:
    - name: zephyr-rtos
      url-base: https://github.com/zephyrproject-rtos
    - name: your-zephyr-rtos-fork
      url-base: https://github.com/your-github-account

  projects:
    - name: zephyr
      repo-path: zephyr
      revision: v3.2.0
      import:
        name-allowlist:
          - cmsis
          - hal_rpi_pico
```
